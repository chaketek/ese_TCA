VERSION ""

NS_ :

BS_: 1000000

BU_: Haltech_TCA2_Emulator

BO_ 1814 TCA2_Temperature_Data: 8 Haltech_TCA2_Emulator
 SG_ CAN_TC1_Diag : 0|4@0+ (1,0) [0|15] "" Vector__XXX
 SG_ CAN_TC1 : 4|12@0+ (0.4071,0) [-250.0|1417.0] "degC" Vector__XXX
 SG_ CAN_TC2_Diag : 16|4@0+ (1,0) [0|15] "" Vector__XXX
 SG_ CAN_TC2 : 20|12@0+ (0.4071,0) [-250.0|1417.0] "degC" Vector__XXX
 SG_ CAN_TC3_Diag : 32|4@0+ (1,0) [0|15] "" Vector__XXX
 SG_ CAN_TC3 : 36|12@0+ (0.4071,0) [-250.0|1417.0] "degC" Vector__XXX
 SG_ CAN_TC4_Diag : 48|4@0+ (1,0) [0|15] "" Vector__XXX
 SG_ CAN_TC4 : 52|12@0+ (0.4071,0) [-250.0|1417.0] "degC" Vector__XXX

CM_ BU_ Haltech_TCA2_Emulator "Haltech TCA2 Thermocouple Amplifier Emulator using MAX6675 sensors. Ref: https://github.com/blacksheepinc/Haltech-wideband-emulator";
CM_ BO_ 1814 "Haltech TCA2 compatible thermocouple temperature data (CAN ID 0x716). 4 channels, each 16-bit: [Diag(4bit)|Temp(12bit)]";
CM_ SG_ 1814 CAN_TC1_Diag "TC1 Diagnostic Code: 0=Normal, 1=Short, 2=Open, 3=Under Range, 4=Over Range";
CM_ SG_ 1814 CAN_TC1 "TC1 Temperature. Conversion: temp = raw * 2381 / 5850 - 250";
CM_ SG_ 1814 CAN_TC2_Diag "TC2 Diagnostic Code: 0=Normal, 1=Short, 2=Open, 3=Under Range, 4=Over Range";
CM_ SG_ 1814 CAN_TC2 "TC2 Temperature. Conversion: temp = raw * 2381 / 5850 - 250";
CM_ SG_ 1814 CAN_TC3_Diag "TC3 Diagnostic Code: 0=Normal, 1=Short, 2=Open, 3=Under Range, 4=Over Range";
CM_ SG_ 1814 CAN_TC3 "TC3 Temperature. Conversion: temp = raw * 2381 / 5850 - 250";
CM_ SG_ 1814 CAN_TC4_Diag "TC4 Diagnostic Code: 0=Normal, 1=Short, 2=Open, 3=Under Range, 4=Over Range";
CM_ SG_ 1814 CAN_TC4 "TC4 Temperature. Conversion: temp = raw * 2381 / 5850 - 250";

BA_DEF_ BO_ "GenMsgCycleTime" INT 0 10000;

BA_DEF_DEF_ "GenMsgCycleTime" 0;

BA_ "GenMsgCycleTime" BO_ 1814 50;

VAL_ 1814 CAN_TC1_Diag 0 "Normal" 1 "Short_Circuit" 2 "Open_Circuit" 3 "Under_Range" 4 "Over_Range";
VAL_ 1814 CAN_TC2_Diag 0 "Normal" 1 "Short_Circuit" 2 "Open_Circuit" 3 "Under_Range" 4 "Over_Range";
VAL_ 1814 CAN_TC3_Diag 0 "Normal" 1 "Short_Circuit" 2 "Open_Circuit" 3 "Under_Range" 4 "Over_Range";
VAL_ 1814 CAN_TC4_Diag 0 "Normal" 1 "Short_Circuit" 2 "Open_Circuit" 3 "Under_Range" 4 "Over_Range";
