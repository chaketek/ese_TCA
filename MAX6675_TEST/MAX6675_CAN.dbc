VERSION ""

NS_ :

BS_:

BU_: MAX6675_Node

BO_ 256 Temperature_Data: 4 MAX6675_Node
 SG_ Temperature_CH1 : 0|16@1+ (0.01,0) [-327.68|327.67] "degC" Vector__XXX
 SG_ Temperature_CH2 : 16|16@1+ (0.01,0) [-327.68|327.67] "degC" Vector__XXX

CM_ BU_ MAX6675_Node "MAX6675 Thermocouple Temperature Sensor Node (2ch)";
CM_ BO_ 256 "Temperature measurement data from 2x MAX6675 K-type thermocouple sensors";
CM_ SG_ 256 Temperature_CH1 "Temperature CH1 measured by MAX6675. Raw value is temperature * 100. Range: 0 to +1024 degC. 0x7FFF = Error";
CM_ SG_ 256 Temperature_CH2 "Temperature CH2 measured by MAX6675. Raw value is temperature * 100. Range: 0 to +1024 degC. 0x7FFF = Error";

BA_DEF_ BO_ "GenMsgCycleTime" INT 0 10000;

BA_DEF_DEF_ "GenMsgCycleTime" 0;

BA_ "GenMsgCycleTime" BO_ 256 100;

VAL_TABLE_ TemperatureStatus 0 "Valid" 1 "Error_Open" ;
